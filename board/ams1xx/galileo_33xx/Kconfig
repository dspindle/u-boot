## board/ams1xx/galileo_33xx/Kconfig
```kconfig
if TARGET_GALILEO_33XX

config SYS_BOARD
	default "galileo_33xx"

config SYS_VENDOR
	default "ams1xx"

config SYS_SOC
	default "am33xx"

config SYS_CONFIG_NAME
	default "galileo_33xx"

endif
```

## configs/ams1xx_defconfig
```kconfig
CONFIG_ARM=y
CONFIG_ARCH_OMAP2PLUS=y
CONFIG_SPL_GPIO_SUPPORT=y
CONFIG_SPL_LIBCOMMON_SUPPORT=y
CONFIG_SPL_LIBGENERIC_SUPPORT=y
CONFIG_AM33XX=y
CONFIG_TARGET_GALILEO_33XX=y
CONFIG_SPL_SERIAL_SUPPORT=y
CONFIG_SPL=y
CONFIG_SMBIOS_PRODUCT_NAME="cm_t335"
CONFIG_ENV_VARS_UBOOT_CONFIG=y
CONFIG_SYS_CONSOLE_INFO_QUIET=y
CONFIG_SUPPORT_RAW_INITRD=y
CONFIG_VERSION_VARIABLE=y
CONFIG_SPL_I2C_SUPPORT=y
CONFIG_SPL_MTD_SUPPORT=y
CONFIG_SPL_POWER_SUPPORT=y
CONFIG_SPL_WATCHDOG_SUPPORT=y
# CONFIG_SPL_AM33XX_ENABLE_RTC32K_OSC is not set
CONFIG_HUSH_PARSER=y
CONFIG_SYS_PROMPT="GALILEO-33XX #"
CONFIG_AUTOBOOT_KEYED=y
CONFIG_AUTOBOOT_ENCRYPTION=y
CONFIG_AUTOBOOT_STOP_STR_SHA256="756272a5cceb72b0283425f726735de5f7ec32324b5f274b65bcf9a22d3577a3"
# CONFIG_CMD_BOOTD is not set
# CONFIG_CMD_BOOTM is not set
CONFIG_CMD_BOOTZ=y
# CONFIG_CMD_BOOTEFI is not set
# CONFIG_CMD_ELF is not set
# CONFIG_CMD_GO is not set
# CONFIG_CMD_IMI is not set
# CONFIG_CMD_XIMG is not set
CONFIG_CMD_ASKENV=y
# CONFIG_CMD_FLASH is not set
CONFIG_CMD_GPIO=y
# CONFIG_CMD_LOADB is not set
# CONFIG_CMD_LOADS is not set
CONFIG_CMD_NAND=y
CONFIG_CMD_PART=y
CONFIG_CMD_MII=y
CONFIG_CMD_PING=y
CONFIG_CMD_MTDPARTS=y
CONFIG_MTDIDS_DEFAULT="nand0=nand"
CONFIG_MTDPARTS_DEFAULT="mtdparts=nand:128k(spl0),128k(spl1),128k(res0),128k(res1),1m(res2),1m(u-boot0),1m(res3),128k(u-boot-env0),128k(u-boot-env1),256k(res4),6m(kernelA),6m(kernelB),256k(dtbA),256k(dtbB),1536k(res5),-(ubi)"
CONFIG_DOS_PARTITION=y
CONFIG_ISO_PARTITION=y
CONFIG_SPL_PARTITION_UUIDS=y
CONFIG_ENV_IS_IN_NAND=y
CONFIG_CMD_PCA953X=y
CONFIG_LED_STATUS=y
CONFIG_LED_STATUS_GPIO=y
CONFIG_LED_STATUS0=y
CONFIG_LED_STATUS_BIT=64
CONFIG_LED_STATUS_BOOT_ENABLE=y
CONFIG_LED_STATUS_BOOT=0
# CONFIG_MMC is not set
CONFIG_NAND=y
# CONFIG_SPL_NAND_AM33XX_BCH is not set
CONFIG_MII=y
CONFIG_DRIVER_TI_CPSW=y
CONFIG_OF_LIBFDT=y
CONFIG_SMBIOS_MANUFACTURER="compulab"
```
